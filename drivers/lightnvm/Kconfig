## drivers/lightnvm/Kconfig
```kconfig
#
# LightNVM configuration
#

menuconfig LIGHTNVM
	bool "LightNVM Open-Channel SSD target support"
	depends on BLK_DEV_LIGHTNVM
	help
	  Say Y here to get to enable Open-channel SSDs compatible with LightNVM
	  to be recognized.

	  LightNVM implements some internals of SSDs within the host.
	  Devices are required to support LightNVM, and allow them to managed by
	  the host. LightNVM is used together with an open-channel firmware, that
	  exposes direct access to the underlying non-volatile memory.

	  If you say N, all options in this submenu will be skipped and disabled;
	  only do this if you know what you are doing.

if LIGHTNVM

config LIGHTNVM_RRPC
	tristate "Round-robin Hybrid Open-Channel SSD"
	depends on BLK_DEV_LIGHTNVM
	---help---
	Allows an open-channel SSD to be exposed as a block device to the
	host. The target is implemented using a linear mapping table and
	cost-based garbage collection. It is optimized for 4K IO sizes.

	See Documentation/lightnvm.txt for details.

endif # LIGHTNVM
```

## drivers/md/lightnvm/Kconfig
```kconfig
config LIGHTNVM_RRPC
	tristate "Round-robin Hybrid Open-Channel SSD"
	depends on BLK_DEV_LIGHTNVM
	---help---
	Allows an open-channel SSD to be exposed as a block device to the
	host. It uses a linear mapping table and optimized for 4K IO
	accesses.

	See Documentation/lightnvm.txt for details.
```

## drivers/nvm/Kconfig
```kconfig
#
# Open-Channel SSD NVM configuration
#

menuconfig NVM
	bool "Open-Channel SSD target support"
	depends on BLK_DEV_NVM
	help
	  Say Y here to get to enable Open-channel SSDs.

	  Open-Channel SSDs implement a set of extension to SSDs, that
	  exposes direct access to the underlying non-volatile memory.

	  If you say N, all options in this submenu will be skipped and disabled
	  only do this if you know what you are doing.

if NVM

config NVM_RRPC
	tristate "Round-robin Hybrid Open-Channel SSD"
	depends on BLK_DEV_NVM
	---help---
	Allows an open-channel SSD to be exposed as a block device to the
	host. The target is implemented using a linear mapping table and
	cost-based garbage collection. It is optimized for 4K IO sizes.

	See Documentation/nvm-rrpc.txt for details.

endif # NVM
```
